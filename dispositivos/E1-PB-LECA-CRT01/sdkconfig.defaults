## dispositivos/E1-PB-LECA-LCK01/main/Kconfig.projbuild
```kconfig
menu "Gabinete de lockers del panol (E1-PB-LECA-LCK01)"
    config LOCKER_ABRIR_REMOTO
        bool "Aceptar la orden remota 'abrir' desde AURA"
        default n
        help
            Apagada por defecto (ADR-009, decision 8): 'abrir' se rechaza con abrir_deshabilitado.
            Mientras la mesh no tenga la etapa 2 de seguridad, un comando falso, o una orden que
            quedo en el broker y se ejecuta horas despues, podria abrir un locker. Se enciende
            SOLO en el banco para las pruebas; una imagen con la opcion encendida exige la firma
            de la catedra (ADR-008) para llegar a una placa instalada.

    config LOCKER_CORTAR_AL_ABRIR
        bool "Cortar el pulso apenas el microswitch marca la puerta abierta"
        default y
        help
            La traba de la FIT0620 es biselada: la puerta cierra sola con la traba afuera, asi que
            una vez abierta no hace falta seguir energizando. Sin esto, si la persona abre al
            segundo, la bobina sigue energizada el resto del pulso sin necesidad.
endmenu
```

## dispositivos/_modelos/PUE-RFID/main/Kconfig.projbuild
```kconfig
menu "Puerta con llavero (PUE-RFID)"
    config PUERTA_RELE_ACTIVO_ALTO
        bool "El modulo de rele se activa con el pin en ALTO"
        default n
        help
            Apagada: modulo de nivel bajo (se activa con el pin en BAJO), el mas comun. Encendida:
            modulo de nivel alto, o de los que traen un jumper H/L puesto en H. Verificar con la
            placa enchufada y sin hacer nada: el LED del rele tiene que estar APAGADO. Si esta
            prendido, esta opcion esta mal elegida y la cerradura queda energizada en reposo.

    config PUERTA_SENSOR_BOTON
        bool "El sensor de la puerta es un boton de banco (SOLO PARA BANCO)"
        default n
        help
            Apagada por defecto: sensor magnetico (reed), con "abierta" = pin en ALTO (iman lejos o
            cable cortado). Encendida: boton de banco que simula la puerta, con "abierta" = pin en
            BAJO. El tipo de sensor se fija al compilar y NO se puede cambiar a distancia
            (ADR-009, decision 10): si set_config lo cambiara, un comando falso haria que una
            puerta armada y abierta figure cerrada. Las puertas instaladas son siempre reed.

    config PUERTA_ABRIR_REMOTO
        bool "Aceptar la orden remota 'abrir' desde AURA"
        depends on !PUERTA_INDEPENDIENTE
        default n
        help
            Apagada por defecto (ADR-009, decision 8). Mientras la mesh no tenga la etapa 2 de
            seguridad, un comando falso que pase como si viniera de la raiz podria abrir cualquier
            puerta, y una orden encolada en el broker se podria ejecutar horas despues. Habilitarla
            exige publicar una imagen nueva, que a su vez exige la firma de la catedra (ADR-008).

    config PUERTA_CARGA_POR_CONSOLA
        bool "Cargar llaveros por la consola USB (SOLO PARA BANCO)"
        depends on !PUERTA_INDEPENDIENTE
        default n
        help
            Agrega comandos por el puerto serie (agregar/quitar/listar) para probar sin gateway.
            No hay autenticacion: quien tenga el cable puede cargar cualquier llavero. No se
            habilita en una puerta instalada.

    config PUERTA_INDEPENDIENTE
        bool "Modo independiente: sin mesh ni conexion a AURA"
        default n
        help
            Apagada por defecto: la puerta es una hoja de la mesh (ADR-009). Encendida (etapa
            transitoria del ADR-009): no se inicia el WiFi ni la mesh y no sale ningun dato de la
            placa. Los llaveros se compilan desde llaveros/<codigo>.h, no hay registro, armado ni
            intrusion, y la puerta abierta se avisa solo con el buzzer. La proteccion de la
            cerradura es la misma. No pide main/config_local.h.

    config PUERTA_CODIGO
        string "Lista de llaveros: nombre del archivo en llaveros/, sin .h"
        depends on PUERTA_INDEPENDIENTE
        default ""
        help
            Codigo de la puerta, por ejemplo E2-P2-RECT-PUE01: se compila la lista de
            llaveros/E2-P2-RECT-PUE01.h. Esos archivos no se versionan. Vacia o sin el archivo, no
            compila. Para probar la compilacion sirve llaveros.ejemplo (UID inventados).
endmenu
```
